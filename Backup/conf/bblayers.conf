## Backup/conf/bblayers.conf
```bitbake
# POKY_BBLAYERS_CONF_VERSION is increased each time build/conf/bblayers.conf
# changes incompatibly
POKY_BBLAYERS_CONF_VERSION = "2"

BBPATH = "${TOPDIR}"
BBFILES ?= ""

BBLAYERS ?= " \
  /home/hosam/poky/meta \
  /home/hosam/poky/meta-poky \
  /home/hosam/poky/meta-raspberrypi \
  "
```
